## examples/minimal_video/managed_components/espressif__esp_peer/examples/peer_demo/sdkconfig.defaults
```kconfig
# Enable FreeRTOS trace
CONFIG_FREERTOS_HZ=1000

# Enable DTLS SRTP
CONFIG_MBEDTLS_SSL_PROTO_DTLS=y
CONFIG_MBEDTLS_SSL_DTLS_SRTP=y
CONFIG_MBEDTLS_X509_CREATE_C=y

# Enable experimental features
CONFIG_IDF_EXPERIMENTAL_FEATURES=y

# Partition table
CONFIG_PARTITION_TABLE_SINGLE_APP_LARGE=y
```

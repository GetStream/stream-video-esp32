## components/stream-video/Kconfig
```kconfig
menu "Stream Video SDK"

config STREAM_VIDEO_JOIN_TASK_STACK
    int "Join flow task stack size"
    range 4096 32768
    default 12288
    help
        Stack size (bytes) for the join flow task. Increase on
        memory-constrained boards or when enabling more features.

config STREAM_VIDEO_VENC_TASK_STACK
    int "Video encoder task stack size"
    range 16384 131072
    default 65536
    help
        Stack size (bytes) for video encoder tasks (venc_0/venc_1).
        Increase if the encoder stack overflows.

endmenu
```

## examples/minimal/main/Kconfig
```kconfig
menu "Stream Video Example"

config STREAM_VIDEO_WIFI_SSID
    string "WiFi SSID"
    default "Airtel_s3"
    help
        WiFi SSID for the example.

config STREAM_VIDEO_WIFI_PASSWORD
    string "WiFi password"
    default ""
    help
        WiFi password for the example.

endmenu
```

## examples/minimal/sdkconfig.defaults
```kconfig
# Default SDK configuration for minimal example
# This file provides default settings for ESP32-S3

# Target chip
CONFIG_IDF_TARGET="esp32s3"

# WiFi
CONFIG_ESP_WIFI_STATIC_RX_BUFFER_NUM=10
CONFIG_ESP_WIFI_DYNAMIC_RX_BUFFER_NUM=32
CONFIG_ESP_WIFI_TX_BUFFER_TYPE=1
CONFIG_ESP_WIFI_DYNAMIC_TX_BUFFER_NUM=32
CONFIG_ESP_WIFI_AMPDU_TX_ENABLED=y
CONFIG_ESP_WIFI_AMPDU_RX_ENABLED=y
CONFIG_ESP_WIFI_AMSDU_TX_ENABLED=y
CONFIG_ESP_WIFI_NVS_ENABLED=y

# WebSocket
CONFIG_ESP_HTTP_CLIENT_ENABLE_HTTPS=y

# Logging
CONFIG_LOG_DEFAULT_LEVEL_INFO=y
CONFIG_LOG_MAXIMUM_LEVEL_VERBOSE=y

# FreeRTOS
CONFIG_FREERTOS_HZ=1000
CONFIG_FREERTOS_TIMER_TASK_STACK_DEPTH=4096

# Stream Video
CONFIG_STREAM_VIDEO_STUN_OVERRIDE="stun:stun.l.google.com:19302"
CONFIG_STREAM_VIDEO_VENC_TASK_STACK=196608
CONFIG_STREAM_VIDEO_USE_FIXED_CAPS=n
CONFIG_STREAM_VIDEO_WIDTH=320
CONFIG_STREAM_VIDEO_HEIGHT=240
CONFIG_STREAM_VIDEO_FPS=20
CONFIG_STREAM_VIDEO_BITRATE=900000
CONFIG_STREAM_VIDEO_CAMERA_FMT_YUV422=y
CONFIG_STREAM_AUDIO_ENABLE=y
CONFIG_STREAM_AUDIO_SAMPLE_RATE=24000
CONFIG_STREAM_AUDIO_CHANNELS=1
CONFIG_STREAM_AUDIO_BITS_PER_SAMPLE=16
CONFIG_STREAM_AUDIO_BITRATE=64000
CONFIG_STREAM_AUDIO_INPUT_GAIN=15
CONFIG_STREAM_AUDIO_AGC_ENABLE=y
CONFIG_STREAM_AUDIO_AGC_GAIN_DB=-3
CONFIG_STREAM_AUDIO_LEVEL_PROBE=n
CONFIG_STREAM_AUDIO_LEVEL_PROBE_MS=500
CONFIG_STREAM_AUDIO_DUMP_OPUS=n
CONFIG_STREAM_AUDIO_DUMP_SECONDS=30
CONFIG_STREAM_AUDIO_DUMP_MAX_BYTES=262144
CONFIG_STREAM_AUDIO_I2S_MODE_TDM=y

# WiFi (menuconfig overrides recommended)
CONFIG_STREAM_VIDEO_WIFI_SSID="Pixel8"
CONFIG_STREAM_VIDEO_WIFI_PASSWORD=""

# Partition table
CONFIG_PARTITION_TABLE_CUSTOM=y
CONFIG_PARTITION_TABLE_CUSTOM_FILENAME="partitions.csv"
CONFIG_PARTITION_TABLE_FILENAME="partitions.csv"

# Flash size
CONFIG_ESPTOOLPY_FLASHSIZE_8MB=y
CONFIG_ESPTOOLPY_FLASHSIZE="8MB"
CONFIG_ESPTOOLPY_FLASHMODE_QIO=y

# Camera
CONFIG_CODEC_I2C_BACKWARD_COMPATIBLE=n
CONFIG_OV3660_SUPPORT=y
CONFIG_COMPILER_OPTIMIZATION_PERF=y
CONFIG_ESP_DEFAULT_CPU_FREQ_MHZ_240=y
CONFIG_ESP_WS_CLIENT_ENABLE_DYNAMIC_BUFFER=y
CONFIG_ESP_WS_CLIENT_SEPARATE_TX_LOCK=y
CONFIG_ESP32S3_DATA_CACHE_64KB=y
CONFIG_ESP32S3_DATA_CACHE_LINE_64B=y
CONFIG_ESP32S3_INSTRUCTION_CACHE_32KB=y
CONFIG_LWIP_DNS_MAX_SERVERS=3
CONFIG_LWIP_SNTP_MAX_SERVERS=2
CONFIG_IDF_EXPERIMENTAL_FEATURES=y
CONFIG_MBEDTLS_EXTERNAL_MEM_ALLOC=y

# PSRAM (required for camera + H264)
CONFIG_SPIRAM=y
CONFIG_SPIRAM_BOOT_INIT=y
CONFIG_SPIRAM_MODE_OCT=y
CONFIG_SPIRAM_TYPE_AUTO=y
CONFIG_SPIRAM_SPEED_80M=y
CONFIG_SPIRAM_SPEED=80
CONFIG_FREERTOS_TASK_CREATE_ALLOW_EXT_MEM=y
CONFIG_SPIRAM_FETCH_INSTRUCTIONS=y
CONFIG_SPIRAM_MALLOC_ALWAYSINTERNAL=256
CONFIG_SPIRAM_MALLOC_RESERVE_INTERNAL=8192
CONFIG_SPIRAM_TRY_ALLOCATE_WIFI_LWIP=y

# Camera DMA tuning (reduce internal DMA block size)
CONFIG_CAMERA_DMA_BUFFER_SIZE_MAX=16384
CONFIG_CAMERA_PSRAM_DMA=n

# mbedTLS - Enable DTLS-SRTP support for WebRTC (required by esp_peer)
CONFIG_MBEDTLS_SSL_DTLS_SRTP=y
CONFIG_MBEDTLS_SSL_PROTO_DTLS=y
CONFIG_MBEDTLS_SSL_DTLS_CONNECTION_ID=y
```
